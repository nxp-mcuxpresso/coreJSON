## Kconfig
```kconfig
#
# Copyright 2024 NXP
#
# SPDX-License-Identifier: MIT
#

menuconfig MCUX_COMPONENT_middleware.freertos.corejson
    bool "corejson"
    default n
    help
        JSON parser
```
