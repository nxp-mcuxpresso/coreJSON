## Kconfig
```kconfig
#
# Copyright 2024-2026 NXP
#
# SPDX-License-Identifier: BSD-3-Clause
#

menuconfig MCUX_COMPONENT_middleware.freertos.corejson
    bool "corejson"
    default n
    help
        JSON parser
```
